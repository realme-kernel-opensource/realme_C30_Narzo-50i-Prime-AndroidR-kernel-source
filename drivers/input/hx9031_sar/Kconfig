## drivers/input/hx9031_sar/Kconfig
```kconfig
#
# SPRD HX9031 Driver
#

config HX9031_SAR
	tristate "TianYiHeXin HX9031_Sar driver"
	depends on I2C
	help
	  Say Y here if you have TianYiHeXin HX9031_Sar controller
	  chip in your system.
	  If unsure, say Y.

	  To compile this driver as a module, choose M here: the
	  module will be called HX9031_Sar Key.
```

## drivers/soc/oppo/Kconfig
```kconfig
#ifdef VENDOR_EDIT
# Bin.Li@EXP.BSP.bootloader.bootflow, 2017/05/15, Add for config oppo  software common soft
config OPPO_DEVICE_IFNO
        bool "config oppo devinfo"
        select OPPO_ARCH_FILE
        help
        define this config to compile devinfo.c for device register.

source "drivers/soc/oppo/oppo_devinfo/Kconfig"

#endif /* VENDOR_EDIT */
```
